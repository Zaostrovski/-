## my-robot-2025_v2/module_hardware/sdkconfig.defaults
```kconfig
# m5rover
CONFIG_ESP_MAIN_TASK_STACK_SIZE=64000
CONFIG_ESP_DEFAULT_CPU_FREQ_MHZ_240=y
CONFIG_ESP_TASK_WDT_EN=n
CONFIG_ESPTOOLPY_FLASHFREQ_80M=y
CONFIG_ESP_CONSOLE_USB_SERIAL_JTAG=y
```
